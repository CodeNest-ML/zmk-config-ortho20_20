#include "ortho20_20.dtsi"

/ {
    kscan0: kscan0 {
        compatible = "zmk,kscan-gpio-matrix";
        diode-direction = "col2row";
        wakeup-source;

        col-gpios
            = <&pro_micro 9 GPIO_ACTIVE_HIGH>    // col0 -> P1.06
            , <&pro_micro 8 GPIO_ACTIVE_HIGH>    // col1 -> P1.04
            , <&pro_micro 7 GPIO_ACTIVE_HIGH>    // col2 -> P0.11
            , <&pro_micro 6 GPIO_ACTIVE_HIGH>    // col3 -> P1.00
            , <&pro_micro 5 GPIO_ACTIVE_HIGH>    // col4 -> P0.24
            , <&pro_micro 4 GPIO_ACTIVE_HIGH>    // col5 -> P0.22
            ;

        row-gpios
            = <&pro_micro 15 (GPIO_ACTIVE_HIGH | GPIO_PULL_DOWN)>
            , <&pro_micro 14 (GPIO_ACTIVE_HIGH | GPIO_PULL_DOWN)>
            , <&pro_micro 16 (GPIO_ACTIVE_HIGH | GPIO_PULL_DOWN)>
            , <&pro_micro 10 (GPIO_ACTIVE_HIGH | GPIO_PULL_DOWN)>
            ;
    };
};

&physical_layout_ortho20_20 {
    kscan = <&kscan0>;
};

